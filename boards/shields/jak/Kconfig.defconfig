## boards/shields/jak/Kconfig.defconfig
```kconfig
if SHIELD_JAK_LEFT

config ZMK_KEYBOARD_NAME
    default "Jak"

config ZMK_SPLIT_ROLE_CENTRAL
    default y

endif

if SHIELD_JAK_LEFT || SHIELD_JAK_RIGHT

config ZMK_SPLIT
    default y

endif
```

## boards/shields/jak/Kconfig.shield
```kconfig
config SHIELD_JAK_LEFT
    def_bool $(shields_list_contains,jak_left)

config SHIELD_JAK_RIGHT
    def_bool $(shields_list_contains,jak_right)
```
